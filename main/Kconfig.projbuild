## main/Kconfig.projbuild
```kconfig
menu "WIFI Configuration"

config WIFI_SSID
    string "WiFi SSID"
    default "myssid"
    help
        SSID (network name) for the example to connect to.

config WIFI_PASSWORD
    string "WiFi Password"
    default "mypassword"
    help
        WiFi password (WPA or WPA2) for the example to use.

endmenu

menu "MQTT Configuration"

config MQTT_HOST
    string "MQTT Host"
    help
        MQTT hostname

config MQTT_PORT
    int "MQTT Port"
    default 1883
    help
        MQTT port (default 1883 unencrypted, 8883 encrypted)

config MQTT_USERNAME
    string "MQTT username"
    default ""
    help
        MQTT username

config MQTT_PASSWORD
    string "MQTT Password"
    default ""
    help
        MQTT password

config MQTT_LWT_TOPIC
    string "MQTT Last Will Topic"
    help
        Topic to use when sending the MQTT "Last Will"

endmenu

menu "Sensor Configuration"

config MCP3008_VREF
    int "MCP3008 Vref"
    default 3300
    help
        MCP3008 Vref voltage (mV)

config SENSOR_V_MIN
    int "Minimum Sensor Voltage"
    default 366
    help
        The minimum voltage that the sensor should read (mV)

config SENSOR_READING_INTERVAL
    int "Sensor Reading Interval"
    default 1000
    help
        The sensor reading interval (ms)

config ADC_MV_PER_PSI_100
    int "Calculated mV per psi (100x)"
    help
        The calculated mV per psi from the ratiometric pressure transducer (100x)

config PIN_MCP3008_MOSI
    int "GPIO pin for MCP3008 MOSI"
    range 0 34
    help
        The pin used to connect to the MCP3008 MOSI pin

config PIN_MCP3008_MISO
    int "GPIO pin for MCP3008 MISO"
    range 0 34
    help
        The pin used to connect to the MCP3008 MISO pin

config PIN_MCP3008_CLK
    int "GPIO pin for MCP3008 Clock"
    range 0 34
    help
        The pin used to connect to the MCP3008 clock pin

config PIN_MCP3008_CS
    int "GPIO pin for MCP3008 Chip Select"
    range 0 34
    help
        The pin used to connect to the MCP3008 CS pin

config PIN_WIFI_STATUS_LED
    int "GPIO pin for WiFi status LED"
    range 0 34
    help
        The pin used to connect to a WiFi status LED

endmenu

menu "InfluxDB Configuration"

config INFLUXDB_HOST
    string "InfluxDB Host"
    help
        The InfluxDB host

config INFLUXDB_UDP_PORT
    string "InfluxDB UDP Port"
    help
        Port of InfluxDB UDP input

endmenu
```
